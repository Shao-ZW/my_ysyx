## npc/Kconfig
```kconfig
mainmenu "NPC Configuration Menu"

choice
  prompt "Base ISA"
  default ISA_riscv
config ISA_riscv
  bool "riscv"
endchoice

config ISA
  string
  default "riscv32" if ISA_riscv && !RV64
  default "riscv64" if ISA_riscv &&  RV64
  default "none"

config ISA64
  depends on ISA_riscv && RV64
  bool
  default y

menu "ISA-dependent Options for riscv"
config RV64
  bool "64-bit RISC-V architecture"
  default n

config RVE
  bool "Use E extension"
  default n
endmenu

choice
  prompt "Running mode"
  default MODE_SYSTEM

config MODE_SYSTEM
  bool "System mode"
  help
    Support full-system functionality, including privileged instructions, MMU and devices.
endchoice

choice
  prompt "Build target"
  default TARGET_NATIVE_ELF
config TARGET_NATIVE_ELF
  bool "Executable on Linux Native"
endchoice

menu "Testing and Debugging"
config WATCHPOINT
  bool "Enable watchpoint"
  default y

config WAVE
  bool "Enable wave"
  default n

config TRACE
  bool "Enable tracer"
  default y

config TRACE_START
  depends on TRACE
  int "When tracing is enabled (unit: number of instructions)"
  default 0

config TRACE_END
  depends on TRACE
  int "When tracing is disabled (unit: number of instructions)"
  default 10000

config ITRACE
  depends on TRACE && TARGET_NATIVE_ELF
  bool "Enable instruction tracer"
  default y

config ITRACE_COND
  depends on ITRACE
  string "Only trace instructions when the condition is true"
  default "true"

config MTRACE
  depends on TRACE && TARGET_NATIVE_ELF
  bool "Enable memory tracer"
  default n

config FTRACE
  depends on TRACE && TARGET_NATIVE_ELF
  bool "Enable function tracer"
  default n

config DIFFTEST
  depends on TARGET_NATIVE_ELF
  bool "Enable differential testing"
  default n
  help
    Enable differential testing with a reference design.
    Note that this will significantly reduce the performance of NPC.

choice
  prompt "Reference design"
  default DIFFTEST_REF_SPIKE
  depends on DIFFTEST
config DIFFTEST_REF_SPIKE
  bool "Spike"
config DIFFTEST_REF_NEMU
  bool "Nemu"
endchoice

config DIFFTEST_REF_PATH
  string
  default "tools/spike-diff" if DIFFTEST_REF_SPIKE
  default "none" if DIFFTEST_REF_NEMU
  default "none"

config DIFFTEST_REF_NAME
  string
  default "spike" if DIFFTEST_REF_SPIKE
  default "nemu" if DIFFTEST_REF_NEMU
  default "none"
endmenu

if MODE_SYSTEM
source "csrc/memory/Kconfig"
source "csrc/device/Kconfig"
endif
```
